## conf/layer.conf
```bitbake
# We have a conf and classes directory, add to BBPATH
BBPATH .= ":${LAYERDIR}"

# We have a recipes-* directories, add to BBFILES
BBFILES += "${LAYERDIR}/recipes-*/*/*.bb \
	${LAYERDIR}/recipes-*/*/*.bbappend"

BBFILE_COLLECTIONS += "baldeagle"
BBFILE_PATTERN_baldeagle = "^${LAYERDIR}/"
BBFILE_PRIORITY_baldeagle = "14"

LAYERSERIES_COMPAT_baldeagle = "warrior"

LAYERDEPENDS_baldeagle = "amd-bsp openembedded-layer"

USE_AMDGPU ?= "yes"
RT_KERNEL_AMD ?= "no"
```

## conf/machine/baldeagle.conf
```bitbake
#@TYPE: Machine
#@NAME: baldeagle

#@DESCRIPTION: Machine configuration for baldeagle systems

# Define kernel type and version
PREFERRED_PROVIDER_virtual/kernel ?= "${@bb.utils.contains('RT_KERNEL_AMD', 'yes', 'linux-yocto-rt', 'linux-yocto', d)}"
PREFERRED_VERSION_linux-yocto ?= "4.19%"

require conf/machine/include/tune-baldeagle.inc
include conf/machine/include/amd-common-configurations-local.inc

XSERVER_RADEON = " \
    xf86-video-amd ${@bb.utils.contains('DISTRO_FEATURES', 'opengl', 'mesa-driver-radeon', '', d)} \
    "
XSERVER_AMDGPU = " \
    xf86-video-amd ${@bb.utils.contains('DISTRO_FEATURES', 'opengl', 'mesa-driver-radeonsi', '', d)} \
    "
XSERVER_NOGPU = " \
    ${@bb.utils.contains('DISTRO_FEATURES', 'opengl', 'mesa-driver-swrast', '', d)} \
    "
XSERVER_GPU = " \
    ${@bb.utils.contains('USE_AMDGPU', 'yes', '${XSERVER_AMDGPU}', '${XSERVER_RADEON}', d)} \
    "
XSERVER_X86_GPU = " \
    ${@bb.utils.contains('RT_KERNEL_AMD', 'yes', '${XSERVER_NOGPU}', '${XSERVER_GPU}', d)} \
    "

XSERVER_baldeagle ?= " \
    ${XSERVER_X86_BASE} \
    ${XSERVER_X86_EXT} \
    ${XSERVER_X86_FBDEV} \
    ${XSERVER_X86_MODESETTING} \
    ${XSERVER_X86_GPU} \
    "

MACHINE_EXTRA_RRECOMMENDS_remove = "grub gpio-test spi-test"

GPU_FIRMWARE = "${@bb.utils.contains('USE_AMDGPU', 'yes', 'amdgpu-firmware', 'radeon-firmware', d)}"

# Depend on radeon firmware if standard non real time kernel is used
MACHINE_EXTRA_RRECOMMENDS += "grub-efi amd-ucode ${@bb.utils.contains('RT_KERNEL_AMD', 'yes', '', '${GPU_FIRMWARE}', d)}"

# Autoload amdgpu if used
KERNEL_MODULE_AUTOLOAD += "${@bb.utils.contains('USE_AMDGPU', 'yes', 'amdgpu', '', d)}"

# Define override to match selected GPU type
MACHINEOVERRIDES =. "${@bb.utils.contains('USE_AMDGPU', 'yes', 'amd:amdx86:amdgpu:', 'amd:amdx86:radeon:', d)}"

# Append console
KERNEL_SERIAL_CONSOLE = "console=ttyS0,115200"

# Getty here
SERIAL_CONSOLES = "115200;ttyS0"

# If using radeon append options
APPEND += "${@bb.utils.contains('USE_AMDGPU', 'yes', '', 'radeon.dpm=1', d)}"

# Make sure microcode and GPU firmware gets installed into any image
IMAGE_INSTALL_append = " amd-ucode ${GPU_FIRMWARE}"
```

## conf/machine/include/tune-baldeagle.inc
```bitbake
DEFAULTTUNE ?= "core2-64"
require conf/machine/include/tune-core2.inc
require conf/machine/include/genericx86-common.inc
```
